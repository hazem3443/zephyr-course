## app/boards/imbox/imbox_defconfig
```kconfig
# SPDX-License-Identifier: Apache-2.0

CONFIG_CONSOLE=y
CONFIG_SERIAL=y
CONFIG_UART_CONSOLE=y

CONFIG_GPIO=y

CONFIG_BOARD_EARLY_INIT_HOOK=y

CONFIG_HEAP_MEM_POOL_SIZE=16384
```

## app/boards/imbox_board/board.yml
```yaml
board:
  name: imbox_board
  full_name: IMBOX Board
  vendor: espressif
  socs:
  - name: esp32
```

## app/drivers/our_driver/Kconfig
```kconfig
config OUR_DRIVER
    bool "Our Driver"
    default y
    help
      Enable support for our custom driver.
      This is a placeholder for your own driver configuration.
```

## dts/bindings/our,driver.yaml
```yaml
description: Our simple counter driver
compatible: "our,driver"
include: "base.yaml"
```
